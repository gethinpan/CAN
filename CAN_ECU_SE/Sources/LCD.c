/*------------------------------------
Code Warrior 5.0
Target : MC9S12XEP100
Crystal: 16.000Mhz
busclock:16.000MHz
pllclock:32.000MHz
============================================*/
#include "derivative.h"
#include "LCD.h"
/*
#define LCD_Data_Dir	DDRA
#define LCD_Data_Out	PORTA
#define LCD_SDA 0x10  //PA4(MOSI)
#define LCD_SCL	0x08  //PA3(SCK)
#define LCD_CD	0x04  //PA2(A0:0-cmd;1-data)
#define LCD_RST	0x02  //PA1(RESET)
#define LCD_CS	0x01  //PA0(CS)

#define LCD_SDA 0x80  //PAD7(MOSI)
#define LCD_SCL	0x40  //PAD6(SCK)
#define LCD_CD	0x20  //PAD5(A0:0-cmd;1-data)
#define LCD_RST	0x10  //PAD4(RESET)
#define LCD_CS	0x08  //PAD3(CS)  
*/
#define LCD_Data_Dir	DDRA
#define LCD_Data_Out	PORTA
#define LCD_SDA 0x80  //PAD7(MOSI)
#define LCD_SCL	0x40  //PAD6(SCK)
#define LCD_CD	0x20  //PAD5(A0:0-cmd;1-data)
#define LCD_RST	0x10  //PAD4(RESET)
#define LCD_CS	0x08  //PAD3(CS) 

#define X_WIDTH 132
#define Y_WIDTH 64
//======================================
const byte F6x8[][6] =
{
    { 0x00, 0x00, 0x00, 0x00, 0x00, 0x00 },   // sp
    { 0x00, 0x00, 0x00, 0x2f, 0x00, 0x00 },   // !
    { 0x00, 0x00, 0x07, 0x00, 0x07, 0x00 },   // "
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    { 0x14, 0x14, 0x14, 0x14, 0x14, 0x14 }    // horiz lines
};
//======================================================
// 128X64I液晶底层驱动[8X16]字体库
// 设计者: powerint
// 描  述: [8X16]西文字符的字模数据 (纵向取模,字节倒序)
// !"#$%&'()*+,-./0123456789:;<=>?@ABCDEFGHIJKLMNOPQRSTUVWXYZ[\]^_`abcdefghijklmnopqrstuvwxyz{|}~
//======================================================
const byte F8X16[]=
{
	0x00,0x00,0x00,0x00,0x00,0x00,0x00,0x00,0x00,0x00,0x00,0x00,0x00,0x00,0x00,0x00,// 0
  0x00,0x00,0x00,0xF8,0x00,0x00,0x00,0x00,0x00,0x00,0x00,0x33,0x30,0x00,0x00,0x00,//!1
  0x00,0x10,0x0C,0x06,0x10,0x0C,0x06,0x00,0x00,0x00,0x00,0x00,0x00,0x00,0x00,0x00,//"2
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  0x00,0x06,0x01,0x01,0x02,0x02,0x04,0x04,0x00,0x00,0x00,0x00,0x00,0x00,0x00,0x00,//~94

};

void LCD_WrDat(byte data)
{
	byte i=8;
	LCD_Data_Out &= ~LCD_CS;
	LCD_Data_Out |= LCD_CD;
  LCD_Data_Out&=~LCD_SCL;
  //asm("nop");    
  while(i--)
  {
    if(data&0x80){LCD_Data_Out|=LCD_SDA;}
    else{LCD_Data_Out&=~LCD_SDA;}
    LCD_Data_Out|=LCD_SCL; 
    asm("nop");
		//asm("nop");            
    LCD_Data_Out&=~LCD_SCL;    
    data<<=1;    
  }
	LCD_Data_Out |= LCD_CS; 
}
void LCD_WrCmd(byte cmd)
{
	byte i=8;
	
	LCD_Data_Out &= ~LCD_CS;
	LCD_Data_Out &= ~LCD_CD;
  LCD_Data_Out&=~LCD_SCL;
  //asm("nop");   
  while(i--)
  {
    if(cmd&0x80){LCD_Data_Out|=LCD_SDA;}
    else{LCD_Data_Out&=~LCD_SDA;}
    LCD_Data_Out|=LCD_SCL;
    asm("nop");
		//asm("nop");             
    LCD_Data_Out&=~LCD_SCL;    
    cmd<<=1;   
  } 	
	LCD_Data_Out |= LCD_CS; 
}
void LCD_Set_Pos(byte x, byte y)
{ 
  LCD_WrCmd(0xb0+y);
  LCD_WrCmd(((x&0xf0)>>4)|0x10);
  LCD_WrCmd((x&0x0f)|0x01); 
} 
void LCD_Fill(byte bmp_data)
{
	byte y,x;
	
	for(y=0;y<8;y++)
	{
		LCD_WrCmd(0xb0+y);
		LCD_WrCmd(0x01);
		LCD_WrCmd(0x10);
		for(x=0;x<X_WIDTH;x++)
			LCD_WrDat(bmp_data);
	}
}
void LCD_CLS(void)
{
	byte y,x;	
	for(y=0;y<8;y++)
	{
		LCD_WrCmd(0xb0+y);
		LCD_WrCmd(0x01);
		LCD_WrCmd(0x10); 
		for(x=0;x<X_WIDTH;x++)
			LCD_WrDat(0);
	}
}
void LCD_DLY_ms(word ms)
{                         
  word a;
  while(ms)
  {
    a=1335;
    while(a--);
    ms--;
  }
  return;
}

void LCD_Init(void)        
{
	LCD_Data_Dir |= 0xff;
	LCD_Data_Out |= LCD_SCL+LCD_CS;	//预制SLK和SS为高电平   	
	
	LCD_Data_Out &= ~LCD_RST;
	LCD_DLY_ms(50);
	LCD_Data_Out |= LCD_RST;
	LCD_DLY_ms(20); 	
	LCD_WrCmd(0xaf);	//0xaf  LCD On
	LCD_WrCmd(0x2f);	//0x2f  设置上电控制模式  	
	LCD_WrCmd(0x60);	//0x81  电量设置模式（显示亮度）
	LCD_WrCmd(0x10);	//指令数据0x0000~0x003f  	
	LCD_WrCmd(0x24);	//0x24  V5内部电压调节电阻设置
	LCD_WrCmd(0xa2);	//0xa2 5V,0xa1 3V3     LCD偏压设置   	
	LCD_WrCmd(0xc0);	//0xc8 正常,0xc0 倒置  Com 扫描方式设置
	LCD_WrCmd(0xa1);	//0xa0 正常,0xa1 反向  Segment方向选择
	LCD_WrCmd(0xa4);	//0xa4  全屏点亮/变暗指令
	LCD_WrCmd(0xa6);	//0xa6  正向反向显示控制指令   	
	LCD_WrCmd(0xac);	//0xac  关闭静态指示器
	LCD_WrCmd(0x00);	//指令数据    	
	LCD_WrCmd(0x40+32);	//0x40+32	设置显示起始行对应RAM
	LCD_Fill(0x00);  //初始清屏
	LCD_Set_Pos(0,0); 
	
} 

//==============================================================
//函数名：LCD_P6x8Str(byte x,byte y,byte *p)
//功能描述：写入一组标准ASCII字符串，横向一个字符5，纵向1
//参数：显示的位置（x,y），y为页范围0～7，要显示的字符串
//返回：无
//==============================================================  
void LCD_P6x8Str(byte x,byte y,byte ch[],byte cnt)
{
  byte c=0,i=0,j=0;      
  while (j<cnt)
  {    
    c =ch[j]-32;
    if(x>122){x=0;y++;}
    LCD_Set_Pos(x,y);    
  	for(i=0;i<6;i++)     
  	  LCD_WrDat(F6x8[c][i]);  
  	x+=6;
  	j++;
  }
}
//==============================================================
//函数名：LCD_P8x16Str(byte x,byte y,byte *p)
//功能描述：写入一组标准ASCII字符串
//参数：显示的位置（x,y），y为页范围0～7，要显示的字符串
//返回：无
//==============================================================  
void LCD_P8x16Str(byte x,byte y,byte ch[])
{
  byte c=0,i=0,j=0;
        
  while (ch[j]!='\0')
  {    
    c =ch[j]-32;
    if(x>120){x=0;y++;}
    LCD_Set_Pos(x,y);    
  	for(i=0;i<8;i++)     
  	  LCD_WrDat(F8X16[c*16+i]);
  	LCD_Set_Pos(x,y+1);    
  	for(i=0;i<8;i++)     
  	  LCD_WrDat(F8X16[c*16+i+8]);  
  	x+=8;
  	j++;
  }
}


void char2hex(byte *ch, byte *hex,byte cnt)
{
	int i;
	int hbyte;
	for (i = 0; i < cnt; ++i)
	{
		hbyte = (ch[i / 2] >> (((i + 1) % 2) << 2)) & 0x0F;
		switch (hbyte)
		{
		case 0x00:
			hex[i] = '0'; break;
		case 0x01:
			hex[i] = '1'; break;
		case 0x02:
			hex[i] = '2'; break;
		case 0x03:
			hex[i] = '3'; break;
		case 0x04:
			hex[i] = '4'; break;
		case 0x05:
			hex[i] = '5'; break;
		case 0x06:
			hex[i] = '6'; break;
		case 0x07:
			hex[i] = '7'; break;
		case 0x08:
			hex[i] = '8'; break;
		case 0x09:
			hex[i] = '9'; break;
		case 0x0A:
			hex[i] = 'A'; break;
		case 0x0B:
			hex[i] = 'B'; break;
		case 0x0C:
			hex[i] = 'C'; break;
		case 0x0D:
			hex[i] = 'D'; break;
		case 0x0E:
			hex[i] = 'E'; break;
		case 0x0F:
			hex[i] = 'F'; break;
		}
	}
	hex[cnt-1] = '\0';
}

  
